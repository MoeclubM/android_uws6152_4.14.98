## drivers/wcn/Kconfig
```kconfig
menu "Unisoc WCN Connectivity (SDIO)"

config WCN_FM
    tristate "Unisoc FM Radio (MARLIN3)"
    depends on MMC
    help
      FM driver for Spreadtrum SC2331/MARLIN3 via SDIO.

config WCN_WLAN
    tristate "Unisoc WLAN (sprdwl_ng)"
    depends on MMC
    help
      WLAN driver for Unisoc platforms (SC2355, SDIO).

config WCN_BT
    tristate "Unisoc Bluetooth TTY (sprdbt_tty)"
    depends on MMC
    help
      Bluetooth TTY driver for Unisoc platforms via SDIO.

endmenu
```
